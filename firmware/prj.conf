## CMakeLists.txt
```
# SPDX-License-Identifier: Apache-2.0
#
# Auracaster dongle: Zephyr LE Audio broadcast controller (HCI H4 over USB CDC ACM)

cmake_minimum_required(VERSION 3.20.0)

find_package(Zephyr REQUIRED HINTS $ENV{ZEPHYR_BASE})
project(auracaster_dongle)

target_sources(app PRIVATE src/main.c src/status_led.c common/auracaster_fw.c)
target_include_directories(app PRIVATE common)
# firmware identity reported to the Mac app (common/auracaster_fw.h)
target_compile_definitions(app PRIVATE AURA_FW_ROLE=1)
```

## west.yml
```
# west manifest for the Auracaster dongle firmware.
# Pins Zephyr and fetches only the modules an nRF52840 BLE controller needs.
manifest:
  self:
    path: auracaster-fw
  remotes:
    - name: zephyrproject-rtos
      url-base: https://github.com/zephyrproject-rtos
  projects:
    - name: zephyr
      remote: zephyrproject-rtos
      revision: v4.4.2
      import:
        name-allowlist:
          - cmsis_6
          - hal_nordic
          - mbedtls
          - tf-psa-crypto
```

## prj.conf
```kconfig
# Auracaster dongle - Zephyr Bluetooth LE controller for Bumble
#
# Transport: HCI H4 over USB CDC ACM (virtual serial port). The Zephyr USB
# HCI class (hci_usb) only moves commands, events and ACL; it has no ISO data
# path, so LE Audio broadcast needs H4 over CDC ACM, which carries ISO (0x05).
# Bumble opens it as  serial:/dev/cu.usbmodem<...>

# --- System / console off (the CDC ACM port is the HCI link) -------------
CONFIG_CONSOLE=n
CONFIG_STDOUT_CONSOLE=n
CONFIG_UART_CONSOLE=n
CONFIG_LOG=n
CONFIG_GPIO=y
CONFIG_SERIAL=y
CONFIG_UART_INTERRUPT_DRIVEN=y
# DTR from the host drives the status LED
CONFIG_UART_LINE_CTRL=y
CONFIG_SYSTEM_WORKQUEUE_STACK_SIZE=1024
CONFIG_MAIN_STACK_SIZE=1024

# --- USB device (CDC ACM serial backend, enabled at boot by the board) ---
CONFIG_CDC_ACM_SERIAL_MANUFACTURER_STRING="Auracaster"
CONFIG_CDC_ACM_SERIAL_PRODUCT_STRING="Auracaster Dongle"

# --- HCI raw, H4 framing --------------------------------------------------
CONFIG_BT=y
CONFIG_BT_HCI_RAW=y
CONFIG_BT_HCI_RAW_H4=y
CONFIG_BT_HCI_RAW_H4_ENABLE=y

# Host-side buffer pools of the raw HCI layer (must match controller)
CONFIG_BT_BUF_CMD_TX_SIZE=255
CONFIG_BT_BUF_EVT_RX_SIZE=255
CONFIG_BT_BUF_EVT_RX_COUNT=16
CONFIG_BT_BUF_ACL_TX_SIZE=251
CONFIG_BT_BUF_ACL_TX_COUNT=4
CONFIG_BT_BUF_ACL_RX_SIZE=255

# --- Roles ----------------------------------------------------------------
CONFIG_BT_BROADCASTER=y
CONFIG_BT_OBSERVER=y
CONFIG_BT_PERIPHERAL=y
CONFIG_BT_CENTRAL=y
CONFIG_BT_MAX_CONN=2
CONFIG_BT_EXT_ADV=y
CONFIG_BT_EXT_ADV_MAX_ADV_SET=2
CONFIG_BT_PER_ADV=y

# --- ISO broadcaster (BIG/BIS) -------------------------------------------
CONFIG_BT_ISO_BROADCASTER=y
CONFIG_BT_ISO_MAX_BIG=1
CONFIG_BT_ISO_MAX_CHAN=2
# HCI ISO data from the host: up to 251 byte payload per packet.
# LC3 48 kHz / 10 ms is 100 (48_2), 120 (48_4) or 155 (48_6) octets per SDU.
CONFIG_BT_ISO_TX_MTU=251
CONFIG_BT_ISO_TX_BUF_COUNT=16

# --- Zephyr open-source link layer (LL_SW_SPLIT) -------------------------
CONFIG_BT_LL_SW_SPLIT=y
CONFIG_BT_CTLR_ADVANCED_FEATURES=y
CONFIG_BT_CTLR_ASSERT_HANDLER=y
CONFIG_BT_HCI_VS_FATAL_ERROR=y
CONFIG_BT_CTLR_DATA_LENGTH_MAX=251
CONFIG_BT_CTLR_RX_BUFFERS=6

# Maximum TX power of the nRF52840
CONFIG_BT_CTLR_TX_PWR_PLUS_8=y

# Extended + periodic advertising (Auracast: EA with Broadcast ID/name,
# PA carrying the BASE)
CONFIG_BT_CTLR_ADV_EXT=y
CONFIG_BT_CTLR_ADV_PERIODIC=y
CONFIG_BT_CTLR_ADV_SET=2
CONFIG_BT_CTLR_ADV_DATA_LEN_MAX=191
CONFIG_BT_CTLR_ADV_AUX_SET=2
CONFIG_BT_CTLR_ADV_SYNC_SET=2
# Advertising data buffers shared by all sets. The default (2) is exhausted
# when a second set is created before the first one is fully removed, which
# showed up as MEMORY_CAPACITY_EXCEEDED on LE Set Periodic Advertising
# Parameters after a preset change (v0.1.0) and then wedged the controller.
CONFIG_BT_CTLR_ADV_DATA_BUF_MAX=4
# v0.1.2: reserve radio time for the advertising data actually set (not the
# 191-byte maximum). EA/PA then steal less airtime from the BIG; v0.1.1 with
# 2 BIS x 120 B x RTN 4 got only ~60 of 200 SDUs/s confirmed.
CONFIG_BT_CTLR_ADV_RESERVE_MAX=n

# Broadcast Isochronous Group: 1 BIG with up to 2 BIS (stereo L/R)
CONFIG_BT_CTLR_ADV_ISO=y
CONFIG_BT_CTLR_ADV_ISO_SET=1
CONFIG_BT_CTLR_ADV_ISO_STREAM_MAX=2
CONFIG_BT_CTLR_ADV_ISO_STREAM_COUNT=2
CONFIG_BT_CTLR_ADV_ISO_PDU_LEN_MAX=251
CONFIG_BT_CTLR_ADV_ISO_SEQUENTIAL=y
CONFIG_BT_CTLR_ADV_ISO_INTERLEAVED=y

# ISO TX path in the controller (ISO-AL sources = BIS count)
CONFIG_BT_CTLR_ISOAL_SOURCES=2
CONFIG_BT_CTLR_ISO_TX_BUFFERS=16
CONFIG_BT_CTLR_ISO_TX_BUFFER_SIZE=251
CONFIG_BT_CTLR_ISO_TX_SDU_LEN_MAX=251
# Late SDUs go to the NEXT BIS event instead of being numbered strictly by the
# host's packet sequence number. With strict numbering a single late SDU
# (USB/host hiccup) left every following SDU "in the past" -> dropped ->
# choppy audio. Non-strict: payload = max(next in sequence, current event).
CONFIG_BT_CTLR_ISOAL_SN_STRICT=n

# --- Robustness -----------------------------------------------------------
# Controller assert / fatal error -> warm reboot instead of halting forever
# (the USB CDC link cannot carry the HCI error event with interrupts locked,
# so a halted dongle looked "hung until replug"). Also reboot when the host
# closes the serial port, so every helper start gets a clean controller.
CONFIG_REBOOT=y
```

## src/main.c
```c
/*
 * Copyright (c) 2016 Nordic Semiconductor ASA
 * Copyright (c) 2015-2016 Intel Corporation
 *
 * SPDX-License-Identifier: Apache-2.0
 */

#include <errno.h>
#include <stddef.h>
#include <stdio.h>
#include <string.h>

#include <zephyr/kernel.h>
#include <zephyr/arch/cpu.h>
#include <zephyr/sys/byteorder.h>
#include <zephyr/logging/log_ctrl.h>
#include <zephyr/logging/log.h>
#include <zephyr/sys/util.h>

#include <zephyr/device.h>
#include <zephyr/init.h>
#include <zephyr/drivers/uart.h>
#include <zephyr/sys/reboot.h>

#include <zephyr/net_buf.h>
#include <zephyr/bluetooth/bluetooth.h>
#include <zephyr/bluetooth/l2cap.h>
#include <zephyr/bluetooth/hci.h>
#include <zephyr/bluetooth/buf.h>
#include <zephyr/bluetooth/hci_raw.h>
#include <zephyr/bluetooth/hci_vs.h>

#include "auracaster_fw.h"

#define LOG_MODULE_NAME hci_uart
LOG_MODULE_REGISTER(LOG_MODULE_NAME);

static const struct device *const hci_uart_dev =
	DEVICE_DT_GET(DT_CHOSEN(zephyr_bt_c2h_uart));
static K_THREAD_STACK_DEFINE(tx_thread_stack, CONFIG_BT_HCI_TX_STACK_SIZE);
static struct k_thread tx_thread_data;
static K_FIFO_DEFINE(tx_queue);

/* RX in terms of bluetooth communication */
static K_FIFO_DEFINE(uart_tx_queue);

#define H4_CMD 0x01
#define H4_ACL 0x02
#define H4_SCO 0x03
#define H4_EVT 0x04
#define H4_ISO 0x05

/* Receiver states. */
#define ST_IDLE 0	/* Waiting for packet type. */
#define ST_HDR 1	/* Receiving packet header. */
#define ST_PAYLOAD 2	/* Receiving packet payload. */
#define ST_DISCARD 3	/* Dropping packet. */

/* Length of a discard/flush buffer.
 * This is sized to align with a Bluetooth HCI packet:
 * 1 byte H:4 header + 32 bytes ACL/event data
 * Bigger values might overflow the stack since this is declared as a local
 * variable, smaller ones will force the caller to call into discard more
 * often.
 */
#define H4_DISCARD_LEN 33

static int h4_read(const struct device *uart, uint8_t *buf, size_t len)
{
	int rx = uart_fifo_read(uart, buf, len);

	LOG_DBG("read %d req %d", rx, len);

	return rx;
}

static bool valid_type(uint8_t type)
{
	return (type == H4_CMD) | (type == H4_ACL) | (type == H4_ISO);
}

/* Function expects that type is validated and only CMD, ISO or ACL will be used. */
static uint32_t get_len(const uint8_t *hdr_buf, uint8_t type)
{
	switch (type) {
	case H4_CMD:
		return ((const struct bt_hci_cmd_hdr *)hdr_buf)->param_len;
	case H4_ISO:
		return bt_iso_hdr_len(
			sys_le16_to_cpu(((const struct bt_hci_iso_hdr *)hdr_buf)->len));
	case H4_ACL:
		return sys_le16_to_cpu(((const struct bt_hci_acl_hdr *)hdr_buf)->len);
	default:
		LOG_ERR("Invalid type: %u", type);
		return 0;
	}
}

/* Function expects that type is validated and only CMD, ISO or ACL will be used. */
static int hdr_len(uint8_t type)
{
	switch (type) {
	case H4_CMD:
		return sizeof(struct bt_hci_cmd_hdr);
	case H4_ISO:
		return sizeof(struct bt_hci_iso_hdr);
	case H4_ACL:
		return sizeof(struct bt_hci_acl_hdr);
	default:
		LOG_ERR("Invalid type: %u", type);
		return 0;
	}
}

static void rx_isr(void)
{
	static struct net_buf *buf;
	static int remaining;
	static uint8_t state;
	static uint8_t type;
	static uint8_t hdr_buf[MAX(sizeof(struct bt_hci_cmd_hdr),
			sizeof(struct bt_hci_acl_hdr))];
	int read;

	do {
		switch (state) {
		case ST_IDLE:
			/* Get packet type */
			read = h4_read(hci_uart_dev, &type, sizeof(type));
			/* since we read in loop until no data is in the fifo,
			 * it is possible that read = 0.
			 */
			if (read) {
				if (valid_type(type)) {
					/* Get expected header size and switch
					 * to receiving header.
					 */
					remaining = hdr_len(type);
					state = ST_HDR;
				} else {
					LOG_WRN("Unknown header %d", type);
				}
			}
			break;
		case ST_HDR:
			read = h4_read(hci_uart_dev,
				       &hdr_buf[hdr_len(type) - remaining],
				       remaining);
			remaining -= read;
			if (remaining == 0) {
				/* Header received. Allocate buffer and get
				 * payload length. If allocation fails leave
				 * interrupt. On failed allocation state machine
				 * is reset.
				 */
				buf = bt_buf_get_tx(bt_buf_type_from_h4(type, BT_BUF_OUT),
						    K_NO_WAIT, NULL, 0);
				if (!buf) {
					LOG_ERR("No available command buffers!");
					state = ST_IDLE;
					return;
				}

				remaining = get_len(hdr_buf, type);

				net_buf_add_mem(buf, hdr_buf, hdr_len(type));
				if (remaining > net_buf_tailroom(buf)) {
					LOG_ERR("Not enough space in buffer");
					net_buf_unref(buf);
					state = ST_DISCARD;
				} else {
					state = ST_PAYLOAD;
				}

			}
			break;
		case ST_PAYLOAD:
			read = h4_read(hci_uart_dev, net_buf_tail(buf),
				       remaining);
			buf->len += read;
			remaining -= read;
			if (remaining == 0) {
				/* Packet received */
				LOG_DBG("putting RX packet in queue.");
				k_fifo_put(&tx_queue, buf);
				state = ST_IDLE;
			}
			break;
		case ST_DISCARD:
		{
			uint8_t discard[H4_DISCARD_LEN];
			size_t to_read = MIN(remaining, sizeof(discard));

			read = h4_read(hci_uart_dev, discard, to_read);
			remaining -= read;
			if (remaining == 0) {
				state = ST_IDLE;
			}

			break;

		}
		default:
			read = 0;
			__ASSERT_NO_MSG(0);
			break;

		}
	} while (read);
}

static void tx_isr(void)
{
	static struct net_buf *buf;
	int len;

	if (!buf) {
		buf = k_fifo_get(&uart_tx_queue, K_NO_WAIT);
		if (!buf) {
			uart_irq_tx_disable(hci_uart_dev);
			return;
		}
	}

	len = uart_fifo_fill(hci_uart_dev, buf->data, buf->len);
	net_buf_pull(buf, len);
	if (!buf->len) {
		net_buf_unref(buf);
		buf = NULL;
	}
}

static void bt_uart_isr(const struct device *unused, void *user_data)
{
	ARG_UNUSED(unused);
	ARG_UNUSED(user_data);

	while (uart_irq_update(hci_uart_dev) && uart_irq_is_pending(hci_uart_dev)) {
		if (!(uart_irq_rx_ready(hci_uart_dev) ||
		      uart_irq_tx_ready(hci_uart_dev))) {
			LOG_DBG("spurious interrupt");
		}

		if (uart_irq_tx_ready(hci_uart_dev)) {
			tx_isr();
		}

		if (uart_irq_rx_ready(hci_uart_dev)) {
			rx_isr();
		}
	}
}

static int h4_send(struct net_buf *buf);

/* Command Complete for a vendor command answered by this bridge itself */
static void aura_cmd_complete(uint16_t opcode, const uint8_t *rp, uint8_t rp_len)
{
	struct net_buf *evt = bt_buf_get_rx(BT_BUF_EVT, K_FOREVER);

	net_buf_add_u8(evt, BT_HCI_EVT_CMD_COMPLETE);
	net_buf_add_u8(evt, 3U + rp_len);
	net_buf_add_u8(evt, 1U); /* Num_HCI_Command_Packets */
	net_buf_add_le16(evt, opcode);
	net_buf_add_mem(evt, rp, rp_len);
	(void)h4_send(evt);
}

/*
 * Auracaster vendor commands (common/auracaster_fw.h), handled before the
 * controller sees them. Returns true when the command was consumed.
 */
static bool aura_vendor_cmd(struct net_buf *buf)
{
	uint16_t opcode;

	/* buf: H4 type, opcode (LE16), parameter length, parameters */
	if (buf->len < 4U || buf->data[0] != H4_CMD) {
		return false;
	}
	opcode = sys_get_le16(&buf->data[1]);

	switch (opcode) {
	case AURA_OP_READ_INFO: {
		uint8_t rp[1 + AURA_FW_INFO_LEN];

		rp[0] = BT_HCI_ERR_SUCCESS;
		aura_fw_info(&rp[1]);
		aura_cmd_complete(opcode, rp, sizeof(rp));
		return true;
	}
	case AURA_OP_ENTER_BOOTLOADER: {
		const uint8_t status = BT_HCI_ERR_SUCCESS;

		aura_cmd_complete(opcode, &status, 1U);
		/* give the event time to leave over USB, then restart */
		k_msleep(150);
		aura_fw_enter_uf2_bootloader();
	}
	default:
		return false;
	}
}

static void tx_thread(void *p1, void *p2, void *p3)
{
	while (1) {
		struct net_buf *buf;
		int err;

		/* Wait until a buffer is available */
		buf = k_fifo_get(&tx_queue, K_FOREVER);
		if (aura_vendor_cmd(buf)) {
			net_buf_unref(buf);
			continue;
		}
		/* Pass buffer to the stack */
		err = bt_send(buf);
		if (err) {
			LOG_ERR("Unable to send (err %d)", err);
			net_buf_unref(buf);
		}

		/* Give other threads a chance to run if tx_queue keeps getting
		 * new data all the time.
		 */
		k_yield();
	}
}

static int h4_send(struct net_buf *buf)
{
	LOG_DBG("buf %p type %u len %u", buf, buf->data[0], buf->len);

	k_fifo_put(&uart_tx_queue, buf);
	uart_irq_tx_enable(hci_uart_dev);

	return 0;
}

#if defined(CONFIG_BT_CTLR_ASSERT_HANDLER)
void bt_ctlr_assert_handle(char *file, uint32_t line)
{
	/* Disable interrupts, this is unrecoverable */
	(void)irq_lock();

	if (IS_ENABLED(CONFIG_BT_HCI_VS_FATAL_ERROR)) {
		struct net_buf *buf;

		/* Prepare vendor specific HCI error event */
		buf = hci_vs_err_assert(file, line);
		if (buf != NULL) {
			uint32_t len;
			uint8_t *data;

			/* Disable interrupt driven, and use polling to be able to transmit while
			 * being in highest priority ISR.
			 */
			uart_irq_rx_disable(hci_uart_dev);
			uart_irq_tx_disable(hci_uart_dev);

			/* Send the event over UART */
			data = &buf->data[0];
			len = buf->len;
			while (len) {
				uart_poll_out(hci_uart_dev, *data);
				data++;
				len--;
			}
		} else {
			LOG_ERR("Can't create Fatal Error HCI event: %s at %d", __FILE__, __LINE__);
		}

		LOG_ERR("Halting system");
	} else {
		LOG_ERR("Controller assert in: %s at %d", file, line);
	}

	/* Flush the logs before locking the CPU */
	LOG_PANIC();

	/* Reboot instead of halting: the host re-opens the port and resyncs
	 * with HCI_Reset. A halted dongle looked "hung until replug".
	 */
	k_busy_wait(20000);
	sys_reboot(SYS_REBOOT_WARM);

	CODE_UNREACHABLE;
}
#endif /* CONFIG_BT_CTLR_ASSERT_HANDLER */

#if defined(CONFIG_BT_HCI_VS_FATAL_ERROR)
void k_sys_fatal_error_handler(unsigned int reason, const struct arch_esf *esf)
{
	/* Disable interrupts, this is unrecoverable */
	(void)irq_lock();

	/* Generate an error event only when there is a stack frame */
	if (esf != NULL) {
		struct net_buf *buf;

		/* Prepare vendor specific HCI error event */
		buf = hci_vs_err_stack_frame(reason, esf);
		if (buf != NULL) {
			uint32_t len;
			uint8_t *data;

			/* Disable interrupt driven, and use polling to be able to transmit while
			 * being in highest priority ISR.
			 */
			uart_irq_rx_disable(hci_uart_dev);
			uart_irq_tx_disable(hci_uart_dev);

			/* Send the event over UART */
			data = &buf->data[0];
			len = buf->len;
			while (len) {
				uart_poll_out(hci_uart_dev, *data);
				data++;
				len--;
			}
		} else {
			LOG_ERR("Can't create Fatal Error HCI event.\n");
		}
	}

	LOG_ERR("Halting system");

	/* Flush the logs before locking the CPU */
	LOG_PANIC();

	/* Reboot instead of halting: the host re-opens the port and resyncs
	 * with HCI_Reset. A halted dongle looked "hung until replug".
	 */
	k_busy_wait(20000);
	sys_reboot(SYS_REBOOT_WARM);

	CODE_UNREACHABLE;
}
#endif /* CONFIG_BT_HCI_VS_FATAL_ERROR */

static int hci_uart_init(void)
{
	LOG_DBG("");

	if (!device_is_ready(hci_uart_dev)) {
		LOG_ERR("HCI UART %s is not ready", hci_uart_dev->name);
		return -EINVAL;
	}

	uart_irq_rx_disable(hci_uart_dev);
	uart_irq_tx_disable(hci_uart_dev);

	uart_irq_callback_set(hci_uart_dev, bt_uart_isr);

	uart_irq_rx_enable(hci_uart_dev);

	return 0;
}

SYS_INIT(hci_uart_init, APPLICATION, CONFIG_KERNEL_INIT_PRIORITY_DEVICE);

int main(void)
{
	/* incoming events and data from the controller */
	static K_FIFO_DEFINE(rx_queue);
	int err;

	LOG_DBG("Start");
	__ASSERT(hci_uart_dev, "UART device is NULL");

	/* Enable the raw interface, this will in turn open the HCI driver */
	bt_enable_raw(&rx_queue);

	if (IS_ENABLED(CONFIG_BT_WAIT_NOP)) {
		/* Issue a Command Complete with NOP */
		int i;

		const struct {
			const uint8_t h4;
			const struct bt_hci_evt_hdr hdr;
			const struct bt_hci_evt_cmd_complete cc;
		} __packed cc_evt = {
			.h4 = H4_EVT,
			.hdr = {
				.evt = BT_HCI_EVT_CMD_COMPLETE,
				.len = sizeof(struct bt_hci_evt_cmd_complete),
			},
			.cc = {
				.ncmd = 1,
				.opcode = sys_cpu_to_le16(BT_OP_NOP),
			},
		};

		for (i = 0; i < sizeof(cc_evt); i++) {
			uart_poll_out(hci_uart_dev,
				      *(((const uint8_t *)&cc_evt)+i));
		}
	}

	/* Spawn the TX thread and start feeding commands and data to the
	 * controller
	 */
	k_thread_create(&tx_thread_data, tx_thread_stack,
			K_THREAD_STACK_SIZEOF(tx_thread_stack), tx_thread,
			NULL, NULL, NULL, K_PRIO_COOP(7), 0, K_NO_WAIT);
	k_thread_name_set(&tx_thread_data, "HCI uart TX");

	while (1) {
		struct net_buf *buf;

		buf = k_fifo_get(&rx_queue, K_FOREVER);
		err = h4_send(buf);
		if (err) {
			LOG_ERR("Failed to send");
		}
	}
	return 0;
}
```

## src/status_led.c
```c
/*
 * Auracaster dongle status LED (P0.15 on nice!nano / Pro Micro nRF52840)
 * and host-session supervisor.
 *
 * LED:
 *  - short blink every second : powered, waiting for the host
 *  - steady on                : host has opened the serial port (DTR set,
 *                               Bumble/auracaster_helper is connected)
 *
 * Supervisor (v0.1.1): when the host closes the serial port (DTR 1 -> 0) the
 * dongle reboots, so every helper start talks to a freshly initialised
 * controller. This also recovers a link layer that stopped answering HCI
 * commands: the helper closes the port, the dongle reboots, the helper
 * re-opens it and resynchronises with HCI_Reset.
 *
 * v0.1.2: "1200 baud touch" - if the host set 1200 baud before dropping DTR,
 * the dongle restarts into the UF2 bootloader instead (Mac app firmware
 * update, like Arduino/CircuitPython boards).
 *
 * SPDX-License-Identifier: Apache-2.0
 */

#include <zephyr/kernel.h>
#include <zephyr/device.h>
#include <zephyr/drivers/gpio.h>
#include <zephyr/drivers/uart.h>
#include <zephyr/sys/reboot.h>

#include "auracaster_fw.h"

static const struct device *const hci_uart = DEVICE_DT_GET(DT_CHOSEN(zephyr_bt_c2h_uart));

#if DT_NODE_EXISTS(DT_ALIAS(led0))
static const struct gpio_dt_spec led = GPIO_DT_SPEC_GET(DT_ALIAS(led0), gpios);
#define HAS_LED 1
#else
#define HAS_LED 0
#endif

static void status_led_thread(void *p1, void *p2, void *p3)
{
	ARG_UNUSED(p1);
	ARG_UNUSED(p2);
	ARG_UNUSED(p3);

	uint32_t tick = 0U;
	uint32_t last_dtr = 0U;
	bool led_ok = false;

#if HAS_LED
	led_ok = gpio_is_ready_dt(&led) && gpio_pin_configure_dt(&led, GPIO_OUTPUT_INACTIVE) == 0;
#endif

	while (true) {
		uint32_t dtr = 0U;

		/* enters the UF2 bootloader on a 1200 baud touch (no return) */
		dtr = aura_fw_touch_poll(hci_uart);

		if (last_dtr && !dtr) {
			/* Host closed the port: confirm for 200 ms, then reboot. */
			k_msleep(200);
			dtr = aura_fw_touch_poll(hci_uart);
			if (!dtr) {
				sys_reboot(SYS_REBOOT_WARM);
			}
		}
		last_dtr = dtr;

#if HAS_LED
		if (led_ok) {
			if (dtr) {
				gpio_pin_set_dt(&led, 1);
			} else {
				/* 100 ms on, 900 ms off */
				gpio_pin_set_dt(&led, (tick % 10U) == 0U);
			}
		}
#else
		ARG_UNUSED(led_ok);
#endif

		tick++;
		k_msleep(100);
	}
}

K_THREAD_DEFINE(status_led, 512, status_led_thread, NULL, NULL, NULL,
		K_LOWEST_APPLICATION_THREAD_PRIO, 0, 500);
```

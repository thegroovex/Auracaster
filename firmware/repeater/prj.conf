## CMakeLists.txt
```
# SPDX-License-Identifier: Apache-2.0
#
# Auracaster Repeater: standalone Auracast relay (BIG sync -> BIG create,
# LC3 SDUs forwarded unchanged). Shares firmware/west.yml with the dongle.

cmake_minimum_required(VERSION 3.20.0)

find_package(Zephyr REQUIRED HINTS $ENV{ZEPHYR_BASE})
project(auracaster_repeater)

target_sources(app PRIVATE src/main.c src/led.c src/host_link.c ../common/auracaster_fw.c)
target_include_directories(app PRIVATE ../common)
# firmware identity reported to the Mac app (common/auracaster_fw.h)
target_compile_definitions(app PRIVATE AURA_FW_ROLE=2)
```

## Kconfig
```
# SPDX-License-Identifier: Apache-2.0
#
# Auracaster Repeater options. Override at build time, e.g.
#   west build ... -- -DCONFIG_AURACAST_REPEATER_BROADCAST_CODE=\"geheim123\"

menu "Auracaster Repeater"

config AURACAST_REPEATER_SOURCE_NAME_PREFIX
	string "Broadcast name prefix of the source to relay"
	default "Auracaster"
	help
	  Only Auracast broadcasts whose Broadcast Name starts with this text
	  are preferred. Empty: every Auracast broadcast matches and the
	  strongest one is taken.

config AURACAST_REPEATER_FALLBACK_STRONGEST
	bool "Fall back to the strongest Auracast broadcast"
	default y
	help
	  If no broadcast matches the name prefix, relay the strongest
	  Auracast broadcast that is in range instead of waiting.

config AURACAST_REPEATER_NAME
	string "Broadcast name of the relay (empty: <source name><suffix>)"
	default ""

config AURACAST_REPEATER_NAME_SUFFIX
	string "Suffix appended to the source name"
	default " +"
	help
	  Also used to recognise other repeaters: broadcasts whose name ends
	  with this suffix are never relayed (no relay chains / loops).

config AURACAST_REPEATER_BROADCAST_CODE
	string "Broadcast Code for encrypted sources (max. 16 bytes UTF-8)"
	default ""
	help
	  Needed to decrypt an encrypted source; the relay is then encrypted
	  with the same code. Same rules as the Auracaster app: plain UTF-8,
	  zero padded to 16 bytes.

config AURACAST_REPEATER_BROADCAST_ID
	hex "Broadcast ID of the relay (0: derived from the chip ID)"
	default 0x0
	range 0x0 0xffffff

config AURACAST_REPEATER_MAX_BIS
	int "Maximum number of BIS (audio channels) relayed"
	default 2
	range 1 2

config AURACAST_REPEATER_RTN
	int "Retransmissions of the relay BIG"
	default 0
	range 0 4
	help
	  Every retransmission makes the relay's BIG event longer. Because
	  the single radio also has to receive the source BIG, short relay
	  events leave more room; see README (Grenzen).

config AURACAST_REPEATER_MAX_LATENCY_MS
	int "Max transport latency of the relay BIG (ms)"
	default 10
	range 5 29
	help
	  Kept below 30 ms so the Zephyr link layer uses one SDU per BIG event
	  (ISO interval = SDU interval) and every SDU leaves immediately.

config AURACAST_REPEATER_PRESENTATION_DELAY_US
	int "Presentation Delay written into the relay BASE (us, 0: copy)"
	default 0
	range 0 100000

config AURACAST_REPEATER_MAX_INFLIGHT
	int "SDUs per BIS that may wait in the controller"
	default 2
	range 1 4
	help
	  Bounds the queue between the two unsynchronised BIGs; older data is
	  dropped instead of letting latency grow from clock drift.

config AURACAST_REPEATER_SCAN_WINDOW_MS
	int "Time to collect candidates before choosing a source (ms)"
	default 2000

config AURACAST_REPEATER_LOSS_TIMEOUT_MS
	int "No valid audio for this long counts as source lost (ms)"
	default 3000

config AURACAST_REPEATER_GRACE_MS
	int "Keep the relay BIG alive this long while resyncing (ms)"
	default 15000
	help
	  Receivers stay synced to the relay while the source is briefly
	  gone; if the same stream comes back it is relayed again without
	  the receivers noticing more than a dropout.

config AURACAST_REPEATER_HW_WATCHDOG
	bool "Hardware watchdog"
	default y
	select WATCHDOG

config AURACAST_REPEATER_STATS_INTERVAL_S
	int "Statistics log interval (s, 0: off)"
	default 10

endmenu

source "Kconfig.zephyr"
```

## prj.conf
```kconfig
# Auracaster Repeater - standalone Auracast relay on a Pro Micro nRF52840
#
# Zephyr host + Zephyr open-source controller (LL_SW_SPLIT) on the same chip:
#   PA sync + BIG sync (ISO sync receiver)  ->  own EA + PA + BIG (ISO broadcaster)
# LC3 SDUs are forwarded byte-for-byte (no codec on the chip).

# --- System ----------------------------------------------------------------
CONFIG_GPIO=y
CONFIG_HWINFO=y
CONFIG_REBOOT=y
# DTR + baud rate of the USB console: 1200 baud touch -> UF2 bootloader,
# "@AURA" status lines for the Mac app (src/host_link.c)
CONFIG_UART_LINE_CTRL=y
CONFIG_EVENTS=y
CONFIG_MAIN_STACK_SIZE=3072
CONFIG_SYSTEM_WORKQUEUE_STACK_SIZE=2048

# --- USB CDC ACM log console (board default backend) -----------------------
CONFIG_LOG=y
CONFIG_LOG_MODE_DEFERRED=y
CONFIG_LOG_BUFFER_SIZE=4096
CONFIG_LOG_BACKEND_UART=y
CONFIG_CDC_ACM_SERIAL_MANUFACTURER_STRING="Auracaster"
CONFIG_CDC_ACM_SERIAL_PRODUCT_STRING="Auracaster Repeater"
# Own PID so the macOS helper never mistakes the repeater for the dongle
CONFIG_CDC_ACM_SERIAL_PID=0x0005

# --- Bluetooth host -----------------------------------------------------------
CONFIG_BT=y
CONFIG_BT_DEVICE_NAME="Auracaster Repeater"
CONFIG_BT_OBSERVER=y
CONFIG_BT_BROADCASTER=y
CONFIG_BT_EXT_ADV=y
CONFIG_BT_EXT_ADV_MAX_ADV_SET=2
CONFIG_BT_PER_ADV=y
CONFIG_BT_PER_ADV_SYNC=y
CONFIG_BT_PER_ADV_SYNC_MAX=1
# Reassemble fragmented EA / PA reports in the host
CONFIG_BT_EXT_SCAN_BUF_SIZE=255
CONFIG_BT_PER_ADV_SYNC_BUF_SIZE=255

CONFIG_BT_ISO_SYNC_RECEIVER=y
CONFIG_BT_ISO_BROADCASTER=y
# one BIG received + one BIG sent, 2 BIS each
CONFIG_BT_ISO_MAX_BIG=2
CONFIG_BT_ISO_MAX_CHAN=4
CONFIG_BT_ISO_TX_MTU=251
CONFIG_BT_ISO_RX_MTU=251
CONFIG_BT_ISO_TX_BUF_COUNT=16
CONFIG_BT_ISO_RX_BUF_COUNT=16
# A source with BN 5 (Auracaster default preset) delivers 5 SDUs per BIS at once

CONFIG_BT_BUF_EVT_RX_SIZE=255
CONFIG_BT_BUF_EVT_RX_COUNT=16
# SDUs are forwarded from the RX callback
CONFIG_BT_RX_STACK_SIZE=2560

# --- Zephyr open-source link layer -------------------------------------------
CONFIG_BT_LL_SW_SPLIT=y
CONFIG_BT_CTLR_ADVANCED_FEATURES=y
CONFIG_BT_CTLR_ASSERT_HANDLER=y
CONFIG_BT_CTLR_TX_PWR_PLUS_8=y

CONFIG_BT_CTLR_ADV_EXT=y
CONFIG_BT_CTLR_ADV_PERIODIC=y
CONFIG_BT_CTLR_SYNC_PERIODIC=y
CONFIG_BT_CTLR_ADV_SET=2
CONFIG_BT_CTLR_ADV_DATA_LEN_MAX=191
CONFIG_BT_CTLR_SCAN_DATA_LEN_MAX=255

# ISO broadcaster (relay BIG) ...
CONFIG_BT_CTLR_ADV_ISO=y
CONFIG_BT_CTLR_ADV_ISO_SET=1
CONFIG_BT_CTLR_ADV_ISO_STREAM_MAX=2
CONFIG_BT_CTLR_ADV_ISO_PDU_LEN_MAX=251
CONFIG_BT_CTLR_ISOAL_SOURCES=2
CONFIG_BT_CTLR_ISO_TX_BUFFERS=16
CONFIG_BT_CTLR_ISO_TX_BUFFER_SIZE=251
CONFIG_BT_CTLR_ISO_TX_SDU_LEN_MAX=251

# ... and ISO synchronized receiver (source BIG) in the same controller.
# Kconfig has no mutual exclusion between BT_CTLR_ADV_ISO and
# BT_CTLR_SYNC_ISO (see README, "Gleichzeitig empfangen und senden").
CONFIG_BT_CTLR_SYNC_ISO=y
CONFIG_BT_CTLR_SCAN_SYNC_ISO_SET=1
CONFIG_BT_CTLR_SYNC_ISO_STREAM_MAX=2
CONFIG_BT_CTLR_SYNC_ISO_PDU_LEN_MAX=251
CONFIG_BT_CTLR_ISOAL_SINKS=2
CONFIG_BT_CTLR_ISO_RX_BUFFERS=16
```

## src/host_link.c
```c
/*
 * Auracaster Repeater <-> Mac app link over the USB CDC ACM console (v0.1.2).
 *
 *  - "1200 baud touch" -> restart into the UF2 bootloader (firmware update
 *    from the app, no reset button needed)
 *  - when the host opens the port (DTR 0 -> 1):
 *        @AURA id role=repeater version=0.1.2 variant=s140v6 load=0x26000 flags=2 board=promicro_nrf52840
 *  - every 2 s while the port is open:
 *        @AURA status state=relaying source="Wohnzimmer" rssi=-61 relay="Wohnzimmer +" rx_ok=.. ...
 *
 * The app shows these lines as "Repeater-Status". Normal log output stays
 * as it is; the "@AURA " prefix makes the machine-readable lines easy to find.
 *
 * SPDX-License-Identifier: Apache-2.0
 */

#include <stddef.h>

#include <zephyr/kernel.h>
#include <zephyr/device.h>
#include <zephyr/sys/printk.h>

#include "auracaster_fw.h"

/* main.c */
void repeater_status_format(char *out, size_t len);

#define STATUS_INTERVAL_MS 2000

static const struct device *const console = DEVICE_DT_GET(DT_CHOSEN(zephyr_console));

static void print_ident(void)
{
	uint8_t info[AURA_FW_INFO_LEN];

	aura_fw_info(info);
	printk("@AURA id role=%s version=%s variant=%s load=0x%05x flags=%u "
	       "board=promicro_nrf52840\n",
	       aura_fw_role_name(), aura_fw_version_string(), aura_fw_variant_name(),
	       (unsigned int)aura_fw_load_address(), (unsigned int)info[10]);
}

static void host_link_thread(void *p1, void *p2, void *p3)
{
	ARG_UNUSED(p1);
	ARG_UNUSED(p2);
	ARG_UNUSED(p3);

	static char line[192];
	uint32_t last_dtr = 0U;
	int64_t next_status = 0;

	while (true) {
		/* enters the UF2 bootloader on a 1200 baud touch (no return) */
		uint32_t dtr = aura_fw_touch_poll(console);

		if (dtr && !last_dtr) {
			k_msleep(300); /* host terminal settles */
			print_ident();
			next_status = 0;
		}
		if (dtr && k_uptime_get() >= next_status) {
			repeater_status_format(line, sizeof(line));
			printk("@AURA status %s\n", line);
			next_status = k_uptime_get() + STATUS_INTERVAL_MS;
		}
		last_dtr = dtr;
		k_msleep(100);
	}
}

K_THREAD_DEFINE(host_link, 1536, host_link_thread, NULL, NULL, NULL,
		K_LOWEST_APPLICATION_THREAD_PRIO, 0, 0);
```

## src/led.c
```c
/*
 * Auracaster Repeater status LED (P0.15, led0 on promicro_nrf52840)
 *
 *   slow blink (0.5 s on / 0.5 s off) : searching for the source
 *   double blink                      : synchronised to the source
 *   steady on                         : relaying (own broadcast on air)
 *   fast blink                        : error (Bluetooth init failed)
 *
 * SPDX-License-Identifier: Apache-2.0
 */

#include <zephyr/kernel.h>
#include <zephyr/drivers/gpio.h>
#include <zephyr/sys/atomic.h>

#include "led.h"

static atomic_t led_state_val = ATOMIC_INIT(LED_SEARCHING);

enum led_state led_get(void)
{
	return (enum led_state)atomic_get(&led_state_val);
}

void led_set(enum led_state state)
{
	atomic_set(&led_state_val, (atomic_val_t)state);
}

#if DT_NODE_EXISTS(DT_ALIAS(led0))

static const struct gpio_dt_spec led = GPIO_DT_SPEC_GET(DT_ALIAS(led0), gpios);

static bool led_on_at(enum led_state state, uint32_t tick)
{
	uint32_t t = tick % 10U; /* 10 x 100 ms frame */

	switch (state) {
	case LED_RELAYING:
		return true;
	case LED_SYNCED:
		return (t == 0U) || (t == 2U);
	case LED_ERROR:
		return (tick & 1U) == 0U;
	case LED_SEARCHING:
	default:
		return t < 5U;
	}
}

static void led_thread(void *p1, void *p2, void *p3)
{
	ARG_UNUSED(p1);
	ARG_UNUSED(p2);
	ARG_UNUSED(p3);

	uint32_t tick = 0U;

	if (!gpio_is_ready_dt(&led) || gpio_pin_configure_dt(&led, GPIO_OUTPUT_INACTIVE)) {
		return;
	}

	while (true) {
		gpio_pin_set_dt(&led, led_on_at((enum led_state)atomic_get(&led_state_val), tick));
		tick++;
		k_msleep(100);
	}
}

K_THREAD_DEFINE(led_tid, 512, led_thread, NULL, NULL, NULL,
		K_LOWEST_APPLICATION_THREAD_PRIO, 0, 0);

#endif /* led0 */
```

## src/led.h
```c
/* SPDX-License-Identifier: Apache-2.0 */
#ifndef REPEATER_LED_H_
#define REPEATER_LED_H_

enum led_state {
	LED_SEARCHING, /* slow blink: looking for the source broadcast      */
	LED_SYNCED,    /* double blink: receiving the source, relay not up  */
	LED_RELAYING,  /* steady on: relay broadcast is on air              */
	LED_ERROR,     /* fast blink: Bluetooth could not be started        */
};

void led_set(enum led_state state);
enum led_state led_get(void);

#endif /* REPEATER_LED_H_ */
```
